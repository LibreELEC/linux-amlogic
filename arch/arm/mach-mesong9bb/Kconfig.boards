## arch/arm/mach-mesong9bb/Kconfig.boards
```kconfig
config MACH_MESONG9BB_COMMON_BOARD
	depends on ARCH_MESONG9BB
	bool "G9BB Common Board"
	default y
	help
	  Support for Amlogic G9BB common development platform.
```

## drivers/amlogic/crypto/Kconfig
```kconfig
menu "Amlogic Crypto Support"

config CRYPTO_AML_HW_CRYPTO
  bool "amlogic HW CRYPTO module"
	select CRYPTO_ALGAPI
	select CRYPTO_BLKCIPHER
	select CRYPTO_HASH
	default y
endmenu
```

## drivers/amlogic/defendkey/Kconfig
```kconfig
#
# amlogic encrypt img judge
#

menu "defend img file update support"

config DEFEND_IMG
	depends on EFUSE
	bool "defend img update"
	default n
	help
		defend update system for board, when system is encrypted, the system img 
		must be encrypted with same key in board

endmenu
```

## drivers/amlogic/display/lcd/Kconfig
```kconfig
#
# Kconfig for Amlogic LCD Devices
#

menu "Amlogic TV LCD Support"

config AML_TV_LCD
	bool "Amlogic TV LCD Driver"
	default n
	help
	  Enable this to choose the drivers for controlling the
	  the LCD panel on TV.

config AML_TV_LCD_V2
	bool "Amlogic TV LCD Driver V2"
	default n
	help
	  Enable this to choose the drivers for controlling the
	  the LCD panel on TV.


endmenu
```

## drivers/amlogic/display/sys_led/Kconfig
```kconfig
menu "Amlogic Sys led Support"

config AMLOGIC_SYS_LED
	bool "Amlogic Sys led support"
	select SETIO_CLASS_DEVICE
	default y
	help
	  Say Y here if you want to use the amlogic system led management.

endmenu
```

## drivers/amlogic/hdmi/Kconfig
```kconfig
menu "HDMI TX Support"

config AML_HDMI_TX_20
        bool "HDMI 2.0 Output Enable"
        default n
        select SWITCH
        select AM_DISPLAY_MODULE
        help  
                hdmi 2.0 output enable. It should be enalbe if board have hdmi 2.0 out interface

config AML_HDMI_TX
        bool "HDMI 1.4 Output Enable"
        default y
        select SWITCH
        select AM_DISPLAY_MODULE
        help
                hdmi 1.4 output enable, It should be enalbe if board have hdmi 1.4 out interface

if AML_HDMI_TX || AML_HDMI_TX_20
config AML_HDMI_TX_HDCP
        bool "HDMI HDCP Enable"
        default n
        help
                hdmitx hdcp enable, it should be enalbe if board burned hdmitx hdcp keys
endif

endmenu
```

## drivers/amlogic/input/irblaster/Kconfig
```kconfig
#
# Input core configuration
#



config AM_IR_IRBLASTER
	tristate "Amlogic irblaster device surport"
	default n
	help
	  Say Y here if you want to use the amlogic irblaster.
```

## drivers/amlogic/nand/nand/aml_nftl_new/Kconfig
```kconfig
#
# Amlogic NAND device configuration
#

menu "Meson NAND Device Support"

config AM_NAND
	bool "Meson NAND flash device"
	default n
	select MTD_NAND
	select MTD_PARTITIONS
	select MTD_BLOCK
	select MTD_CHAR
	select MTD
	help
	  Support for NAND flash on Amlogic Meson platforms

config AM_NAND_RBPIN
	bool "Meson NAND RB bit support"
	depends on AM_NAND
	depends on ARCH_MESON3 || ARCH_MESON6
	default y
	help
	  Support NAND RB bit

config AML_NAND_ENV
	bool "Meson NAND environment variable device (dev/nand_env) support"
	depends on AM_NAND
	depends on ARCH_MESON3 || ARCH_MESON6
	default y
	help
	  Support NAND environment variable device

config AML_NAND_KEY
	bool "Meson key data store in nand device(dev/nand_key) support"
	depends on AM_NAND
	depends on ARCH_MESON3 || ARCH_MESON6
	default n
	help
	  Support   key variable store in NAND device

config NAND_KEY_BLOCK_NUM
	int "config nand key area block number"
	depends on AML_NAND_KEY
	range 2  16
	default 8
	help
		config nand key block number, the number must be even number

config AML_NFTL
	tristate "Meson NAND FTL support"
	depends on AM_NAND
	default n
	help
	  Support NAND Flash Translation Layer

config AML_NFTL_NEW
	tristate "Meson NAND NEW_FTL support"
	depends on AM_NAND
	default m
	help
	  Support NAND Flash New Translation Layer
config AML_NEXT_NAND
	tristate "Meson NAND NEW_FTL support"
	default y
	help
	  Support NAND Flash OLD Translation Layer

endmenu
```

## drivers/amlogic/pm/Kconfig
```kconfig
# Amlogic GPIO


config MESON_SUSPEND
    boolean "Meson suspend driver"
    select WAKELOCK
    help
      This is the Amlogic suspend  driver

config M8M2_SUSPEND
    boolean "Meson suspend driver for 32bit"
    depends on MESON_SUSPEND
    help
      This is the Amlogic suspend  driver

config GXBB_SUSPEND
    boolean "Meson suspend driver for 64bit"
    depends on MESON_SUSPEND
    help
      This is the Amlogic suspend  driver

config GXBB_FORCE_POWER_ON_STATE_AFTER_RESUME
    bool "Force to request the Power ON state after a resume"
    depends on WAKELOCK && EARLYSUSPEND && GXBB_SUSPEND
    default n
    help
      Force to request the Power ON state after a resume, causing to execute the late resume
      and prevent transition back into the suspended state.
```

## drivers/amlogic/smartcard/Kconfig
```kconfig
#
# Smart card driver configuration
#

menu "Smartcard support"

config AM_SMARTCARD
	tristate "Amlogic Smartcard driver"
	default n
	help
		Select to enable Smartcard driver.

if AM_SMARTCARD
config AM_SMARTCARD_GPIO_FOR_DET
	bool "Use GPIO for DETECT pin"
	default n
	help
		Select to enable DETECT in GPIO mode.

config AM_SMARTCARD_GPIO_FOR_RST
	bool "Use GPIO for RESET pin"
	default n
	help
		Select to enable RESET in GPIO mode.
endif
endmenu
```

## drivers/amlogic/thermal/Kconfig
```kconfig
# Amlogic Thermal


config AML_VIRTUAL_THERMAL
    bool "Amlogic virtual thermal interface"
    default y
    help
        Say Y if you want use amlogic virtual thermal interface
config AML_PLATFORM_THERMAL 
    bool "Amlogic platform thermal interface"
    default n
    help 
    Say Y if you want use amlogic platform thermal interface
```

## drivers/amlogic/uart/Kconfig
```kconfig
#
# Amlogic driver configuration
#

config AM_UART
    bool "Serial support"
    depends on PLAT_MESON
	select SERIAL_CORE
	default y
    help
	Add support for the Amlogic serial port.

config AM_UART_CONSOLE
	bool "Console on Amlogic Serial port"
	depends on AM_UART
	select SERIAL_CORE_CONSOLE
	default y
	help
		Support for running a console on the Amlogic serial
		
config PRINTK_NOBLOCK_MODE
	bool "Printk run with no block"
	depends on AM_UART_CONSOLE
	select SERIAL_CORE_CONSOLE
	default n
	help
		Support for printk running with no block
source "drivers/amlogic/uart/gps_um220/Kconfig"
```

## drivers/amlogic/uart/gps_um220/Kconfig
```kconfig
#
# UM220 gps driver configuration
#

menu "Amlogic UM220 GPS Support"
config GPS_UM220
	bool "um220 gps support"
	default n
	---help---	  
	    This module adds support for um220 gps control.
endmenu
```

## drivers/amlogic/usb/Kconfig
```kconfig
menu "USB Support"

config AMLOGIC_USB_3
	tristate "Amlogic USB 3.0 controller support"
	select CONFIG_USB_DWC3
	select CONFIG_USB_XHCI_HCD
	select CONFIG_USB_ARCH_HAS_XHCI
	select CONFIG_USB_PHY
	select CONFIG_AMLOGIC_USB2PHY
  select CONFIG_AMLOGIC_USB3PHY
	depends on USB
	help
	   dwc3 USB host controller

config AMLOGIC_USB
	tristate "Amlogic USB controller support"
	select USB_DWC_OTG_HCD
	select USB_HOST_ELECT_TEST
	select OF_LM
	depends on USB
	help
	   dwc_otg USB host controller

config USB_DWC_OTG_HCD
	bool "USB Host controller dwc_otg support"
	depends on AMLOGIC_USB

config USB_HOST_ELECT_TEST
	bool
	help
	    Enable this config to support USB High speed electric test.

#config DWC_USB_NAK_IN_TIMER
#	bool "Disable DWC OTG USB NAK ISR"
#	depends on USB_DWC_OTG_HCD
#	default n
#	help
#		[y]Enable this config to disable DWC OTG USB NAK interrupt handler.
#			 The handler is moved to timer.
#		[n]Disable this config to let NAK handler in interrupt.
#		Don't change this if you don't know what it is.

endmenu
```

## drivers/amlogic/vfd/Kconfig
```kconfig
config VFD
tristate "Venus VFD Driver"
default n
help
This is the Venus VFD driver.
```

## drivers/amlogic/wifi/Kconfig
```kconfig
menuconfig AM_WIFI
	bool "WiFi support"
	default n

if AM_WIFI
config AM_WIFI_SD_MMC
	bool "Amlogic SDIO Wi-Fi support"
	depends on AM_WIFI
	default n

config DHD_USE_STATIC_BUF
    bool "broadcom wifi static buff support"
    default n

config AM_WIFI_USB
	bool "Amlogic USB Wi-Fi Dongle Support"
	depends on AM_WIFI
	default n

source "drivers/amlogic/wifi/rtl8189ES/Kconfig"
source "drivers/amlogic/wifi/rtl8192EU/Kconfig"
source "drivers/amlogic/wifi/rtl8723AU/Kconfig"
source "drivers/amlogic/wifi/rtl8723BS/Kconfig"
source "drivers/amlogic/wifi/rtl8811AU/Kconfig"
source "drivers/amlogic/wifi/rtl8812AU/Kconfig"
source "drivers/amlogic/wifi/rtl8xxx_CU/Kconfig"
source "drivers/amlogic/wifi/rtl8xxx_DU/Kconfig"
source "drivers/amlogic/wifi/rtl8xxx_EU/Kconfig"
source "drivers/amlogic/wifi/rtl8xxx_EU_MP/Kconfig"
source "drivers/amlogic/wifi/broadcm_40181/Kconfig"

endif # AM_WIFI
```

## drivers/amlogic/wifi/broadcm_40181/Kconfig
```kconfig
config SDIO_DHD_CDC_WIFI_40181_MODULE
	tristate "Broadcom 4329/4330 wireless cards support"
	depends on AM_WIFI_SD_MMC || SD_MMC
#        select WIRELESS_EXT
#        select WEXT_PRIV
	---help---
	  This module adds support for wireless adapters based on
	  Broadcom 4329/30 chipset.

config BCMDHD_FW_PATH
	depends on SDIO_DHD_CDC_WIFI_40181_MODULE
	string "Firmware path"
	default "/system/etc/wifi/fw_bcmdhd.bin"
	---help---
	  Path to the firmware file.

config BCMDHD_NVRAM_PATH
	depends on SDIO_DHD_CDC_WIFI_40181_MODULE
	string "NVRAM path"
	default "/system/etc/wifi/nvram.txt"
	---help---
	  Path to the calibration file.

config BCMDHD_CONFIG_PATH
	depends on SDIO_DHD_CDC_WIFI_40181_MODULE
	string "Config path"
	default "/system/etc/wifi/config.txt"
	---help---
	  Path to the driver configuration file.

config BCMDHD_POWER_OFF_IN_SUSPEND
	depends on SDIO_DHD_CDC_WIFI_40181_MODULE
    bool "Power off in suspend"
	default n
    ---help---
	  Shut down Wi-Fi power in suspend.

config BCMDHD_WEXT
	bool "Enable WEXT support"
	depends on SDIO_DHD_CDC_WIFI_40181_MODULE && CFG80211 = n
	select WIRELESS_EXT
	select WEXT_PRIV
	help
	  Enables WEXT support

choice
	depends on SDIO_DHD_CDC_WIFI_40181_MODULE
	prompt "Interrupt type"
	---help---
	  Interrupt type
config BCMDHD_OOB
	depends on SDIO_DHD_CDC_WIFI_40181_MODULE
	bool "Out-of-Band Interrupt"
	default y
	---help---
	  Interrupt from WL_HOST_WAKE.
config SDIO_HARD_IRQ
	depends on SDIO_DHD_CDC_WIFI_40181_MODULE
	bool "In-Band Interrupt"
	---help---
	  Interrupt from SDIO DAT[1]
endchoice
```

## drivers/amlogic/wifi/rtl8xxx_EU_MP/Kconfig
```kconfig
config RTL8188EU_MP
	tristate "Realtek 8188EU-MP USB WiFi"
	depends on USB
	---help---
	  Help message of RTL8188EU
```

## fs/exfat/Kconfig
```kconfig
config EXFAT_FS
	tristate "exFAT fs support"
	select NLS
	help
	  This adds support for the exFAT file system.

config EXFAT_DEFAULT_CODEPAGE
	int "Default codepage for exFAT"
	default 437
	depends on EXFAT_FS
	help
	  This option should be set to the codepage of your exFAT filesystems.

config EXFAT_DEFAULT_IOCHARSET
	string "Default iocharset for exFAT"
	default "utf8"
	depends on EXFAT_FS
	help
	  Set this to the default input/output character set you'd like exFAT to use.
```

## sound/soc/aml/m8/Kconfig
```kconfig
config SND_AML_M8
	tristate "AML-SND-M8 Board"
	depends on SND_AML_M8_SOC && SWITCH
	select SND_SOC_AML_M8_CODEC if SND_AML_M8
	select SND_SOC_RT5616 if SND_AML_M8
	select SND_SOC_DUMMY_CODEC
	select SND_SOC_WM8960
	select SND_SOC_RT5631
	select SND_SOC_AMLPMU3 if AML1218
	select SND_SOC_AMLPMU4 if AML1220
	select SND_SOC_ES8323

config SND_AML_G9TV
	tristate "AML-SND-G9TV Board"
	depends on SND_AML_M8_SOC && SWITCH
	select SND_SOC_DUMMY_CODEC
	select SND_SOC_AMLPMU4 if AML1220
	select SND_SOC_TAS5707
	
config SND_AML_M8_PCM
	tristate "M8 evaluation board with PCM2BT"
	depends on SND_AML_M8_SOC
	select SND_SOC_PCM2BT if SND_AML_M8_PCM

config SND_AML_M_DUMMY_CODEC
    tristate "AML M series board with DUMMY_CODEC"
    select SND_SOC_DUMMY_CODEC
```
